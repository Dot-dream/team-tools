# AC7802x register map
Vendor: AutoChips; Series: AC78; File version: 1.0
AC7802x Microcontroller
CPU: CM0PLUS r0p1, little endian, no MPU, no FPU, VTOR, 2 interrupt priority bits
Registers are 32-bit, read-write, reset 0x0 unless marked. A register's access mark holds for its fields unless they carry their own. Offsets are from the block's base; lines under a group give offsets from that group; [hi:lo] are bit positions; {n}, {i} and the like mark numbered series; 'fields as' and 'values as' point back to an identical list; <NAME> marks a mode.

## Memory map
0x20080000 GPIOA size 0x28 — General Purpose Input/Output
0x20080030 GPIOB size 0x28
0x20080140 PMUX size 0xC — PinMux Function
0x20080160 EXTI size 0x20 — External Interrupt
0x40000000 CKGEN size 0x20 — Clock Generator
0x40000020 ECC_SRAM size 0xC — SRAM Error Check and Correction
0x40002000 EFLASH size 0x4C — Embedded Flash
0x40003000 ADC0 size 0x1000 — Analog to Digital Converter
0x40005000 ACMP0 size 0x100 — Analog comparator
0x40008000 SPM size 0x20 — System Power Manage
0x40008400 RTC size 0x14 — Real-time counter
0x40008800 ANA_RG size 0x100 — Analog Register
0x4000B000 WDG size 0x14 — Watchdog
0x4000C000 SPI0 size 0x18 — Serial Peripheral Interface
0x4000E000 I2C0 size 0x34 — Inter-Integrated Circuit
0x40011000 TIMER_CTRL size 0x100 — Timer Control
0x40011100 TIMER_CHANNEL0 size 0x10 — Timer channel
0x40011110 TIMER_CHANNEL1 size 0x10
0x40011120 TIMER_CHANNEL2 size 0x10
0x40011130 TIMER_CHANNEL3 size 0x10
0x40013000 PWM0 size 0xA0 — Pulse Width Modulation
0x40014000 PWM1 size 0xA0
0x40015000 PWM2 size 0xA0 — Pulse Width Modulation
0x40016000 CTU size 0x10 — Connect Module Unit
0x40017000 PWDT size 0x12 — Pulse Width Detection Timer
0x40018000 UART0 size 0x64 — Universal Asynchronous Receiver/Transmitter
0x4001A000 UART1 size 0x64

## Interrupts
0 PWDT0 (PWDT) — PWDT0 interrupt
1 PWM0 — PWM0 interrupt
2 PWM1 — PWM1 interrupt
3 PWM2 — PWM2 interrupt
4 ACMP0 — ACMP0 interrupt
5 UART0 — UART0 interrupt
6 UART1 — UART1 interrupt
8 WDG — WDG interrupt
9 SPI0 — SPI0 interrupt
11 I2C0 — I2C0 Interrupt
17 TIMER_CHANNEL0 — TIMER channel 0 interrupt
18 TIMER_CHANNEL1 — TIMER channel 1 interrupt
19 TIMER_CHANNEL2 — TIMER channel 2 interrupt
20 TIMER_CHANNEL3 — TIMER channel 3 interrupt
21 RTC — RTC Interrupt
23 SPM — SPM interrupt
25 ADC0 — ADC0 interrupt
26 ECC_SRAM — ECC SRAM interrupt
27 EXTI0 (EXTI) — GPIOx PIN0 external interrupt
28 EXTI1 (EXTI) — GPIOx PIN1 external interrupt
29 EXTI2 (EXTI) — GPIOx PIN2 external interrupt
30 EXTI3_8 (EXTI) — GPIOx PIN3~8 external interrupt
31 EXTI9_15 (EXTI) — GPIOx PIN9~15 external interrupt

## Licence text in the file
Copyright Statement: . This software/firmware and related documentation ("AutoChips Software") are protected under relevant copyright laws. The information contained herein is confidential and proprietary to AutoChips Inc. and/or its licensors. Without the prior written permission of AutoChips inc. and/or its licensors, any reproduction, modification, use or disclosure of AutoChips Software, and information contained herein, in whole or in part, shall be strictly prohibited. . AutoChips Inc. (C) 2022. All rights reserved. . BY OPENING THIS FILE, RECEIVER HEREBY UNEQUIVOCALLY ACKNOWLEDGES AND AGREES. THAT THE SOFTWARE/FIRMWARE AND ITS DOCUMENTATIONS ("AUTOCHIPS SOFTWARE"). RECEIVED FROM AUTOCHIPS AND/OR ITS REPRESENTATIVES ARE PROVIDED TO RECEIVER. ON AN "AS-IS" BASIS ONLY. AUTOCHIPS EXPRESSLY DISCLAIMS ANY AND ALL. WARRANTIES, EXPRESS OR IMPLIED, INCLUDING BUT NOT LIMITED TO THE IMPLIED. WARRANTIES OF MERCHANTABILITY, FITNESS FOR A PARTICULAR PURPOSE OR. NONINFRINGEMENT. NEITHER DOES AUTOCHIPS PROVIDE ANY WARRANTY WHATSOEVER WITH. RESPECT TO THE SOFTWARE OF ANY THIRD PARTY WHICH MAY BE USED BY, INCORPORATED IN, OR SUPPLIED WITH THE AUTOCHIPS SOFTWARE, AND RECEIVER AGREES. TO LOOK ONLY TO SUCH THIRD PARTY FOR ANY WARRANTY CLAIM RELATING THERETO. RECEIVER EXPRESSLY ACKNOWLEDGES THAT IT IS RECEIVER'S SOLE RESPONSIBILITY TO. OBTAIN FROM ANY THIRD PARTY ALL PROPER LICENSES CONTAINED IN AUTOCHIPS. SOFTWARE. AUTOCHIPS SHALL ALSO NOT BE RESPONSIBLE FOR ANY AUTOCHIPS SOFTWARE. RELEASES MADE TO RECEIVER'S SPECIFICATION OR TO CONFORM TO A PARTICULAR. STANDARD OR OPEN FORUM. RECEIVER'S SOLE AND EXCLUSIVE REMEDY AND AUTOCHIPS'S. ENTIRE AND CUMULATIVE LIABILITY WITH RESPECT TO THE AUTOCHIPS SOFTWARE. RELEASED HEREUNDER WILL BE, AT AUTOCHIPS'S OPTION, TO REVISE OR REPLACE THE. AUTOCHIPS SOFTWARE AT ISSUE, OR REFUND ANY SOFTWARE LICENSE FEES OR SERVICE. CHARGE PAID BY RECEIVER TO AUTOCHIPS FOR SUCH AUTOCHIPS SOFTWARE AT ISSUE.
