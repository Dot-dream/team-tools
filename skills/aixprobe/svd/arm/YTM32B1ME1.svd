# YTM32B1ME1 register map
Vendor: YTMicro; File version: 1.0
YTM32B1ME1 YTMicro Microcontroller
CPU: CM33 r0p4, little endian, MPU, FPU, 2 interrupt priority bits
Registers are 32-bit, read-write, reset 0x0 unless marked. A register's access mark holds for its fields unless they carry their own. Offsets are from the block's base; lines under a group give offsets from that group; [hi:lo] are bit positions; {n}, {i} and the like mark numbered series; 'fields as' and 'values as' point back to an identical list; <NAME> marks a mode.

## Memory map
0x40020000 DMA0 size 0x1200 — Direct Memory Access
0x4003C000 EEPROM size 0x308 — Electrically Erasable Programmable Read-Only Memory
0x40040000 EFM size 0x30C — Embedded Flash Module
0x40044000 GPIOA size 0xFF — General Purpose Input/Output
0x40044100 GPIOB size 0xFF — General Purpose Input/Output
0x40044200 GPIOC size 0xFF — General Purpose Input/Output
0x40044300 GPIOD size 0xFF — General Purpose Input/Output
0x40044400 GPIOE size 0xFF — General Purpose Input/Output
0x40048000 PCTRLA size 0x80 — PORT Control
0x4004C000 PCTRLB size 0x80 — PORT Control
0x40050000 PCTRLC size 0x80 — PORT Control
0x40054000 PCTRLD size 0x80 — PORT Control
0x40058000 PCTRLE size 0x80 — PORT Control
0x4006C000 UART0 size 0x20 — UART module with LIN mode support
0x40070000 UART1 size 0x20 — UART module with LIN mode support
0x40074000 UART2 size 0x20 — UART module with LIN mode support
0x40078000 UART3 size 0x20 — UART module with LIN mode support
0x4007C000 UART4 size 0x20 — UART module with LIN mode support
0x40080000 UART5 size 0x20 — UART module with LIN mode support
0x40094000 I2C0 size 0x120 — Inter-Integrated Circuit
0x40098000 I2C1 size 0x120 — Inter-Integrated Circuit
0x4009C000 I2C2 size 0x120 — Inter-Integrated Circuit
0x400A8000 SPI0 size 0x28 — Serial Port Interface
0x400AC000 SPI1 size 0x28 — Serial Port Interface
0x400B0000 SPI2 size 0x28 — Serial Port Interface
0x400B4000 SPI3 size 0x28 — Serial Port Interface
0x400B8000 SPI4 size 0x28 — Serial Port Interface
0x400BC000 SPI5 size 0x28 — Serial Port Interface
0x400D0000 CAN0 size 0xC08 — FlexCAN module
0x400D4000 CAN1 size 0xC08 — FlexCAN module
0x400D8000 CAN2 size 0xC08 — FlexCAN module
0x400DC000 CAN3 size 0xC08 — FlexCAN module
0x40100000 ADC0 size 0xBC — Analog-to-Digital Converter
0x40104000 ADC1 size 0xBC — Analog-to-Digital Converter
0x4010C000 ACMP0 size 0x34 — Analog comparator module
0x40120000 TMU size 0x20 — Trigger Multiplexer Module
0x40124000 eTMR0 size 0x268 — Enhanced timer
0x40128000 eTMR1 size 0x268 — Enhanced timer
0x4012C000 eTMR2 size 0x268 — Enhanced timer
0x40130000 eTMR3 size 0x268 — Enhanced timer
0x40144000 MPWM0 size 0x400 — Multiple Pulse Width Modulation
0x40150000 TMR0 size 0x20 — Timer have one 32-bit counter use clock from an 8-bit prescaler, and it have four 32-bit compare channels with independent interrupt.
0x40160000 SENT0 size 0xB0 — Single Edge Nibble Transmission
0x40168000 pTMR0 size 0x140 — Periodic timer
0x40174000 lpTMR0 size 0x18 — Low Power Timer
0x40180000 RTC size 0x20 — Real Time Clock provides a real time counter which is present in always on domain.
0x40184000 REGFILE size 0x20 — Register File
0x40188000 WKU size 0x2C — Wake-up Unit
0x40194000 PCRC size 0x10 — Programmable Cyclic Redundancy Check
0x40198000 TRNG size 0x50 — True Random Number Generator
0x4019C000 HCU size 0xB8 — Hardware Cryptography Unit
0x401A8000 WDG0 size 0x20 — Watchdog module
0x401AC000 EWDG0 size 0x14 — External Watchdog
0x401C4000 INTM size 0x12C — Interrupt Monitor Unit
0x401C8000 EMU0 size 0x16C — ECC Management Unit
0x401EC000 CIM size 0x8C — Chip Integration Module of Microcontroller
0x401F0000 SCU size 0x58 — System Clock Unit of Microcontroller
0x401F4000 IPC size 0x1FC — IP Control
0x401F8000 PCU size 0x14 — Power control unit
0x401FC000 RCU size 0x8 — Reset Contru Unit of Microcontroller
0xE0080000 CACHE size 0x5C — Cache Controller and Cache Array

## Licence text in the file
YTMicro Microcontroller all rights reserved.
